## main/Kconfig.projbuild
```kconfig
menu "Example Configuration"

    # ==================== WIFI sub-menu ====================
    menu "WIFI Configuration"

        config ESP_WIFI_SSID
            string "WiFi SSID"
            default "myssid"
            help
                SSID (network name) for the example to connect to.

        config ESP_WIFI_PASSWORD
            string "WiFi Password"
            default "mypassword"
            help
                WiFi password (WPA or WPA2) for the example to use.

        config ESP_MAXIMUM_RETRY
            int "Maximum retry"
            default 5
            help
                Set the Maximum retry to avoid station reconnecting to the AP unlimited when the AP is really inexistent.

        config ESP_WIFI_MAX_TX_POWER
            int "Maximum TX Power"
            default 50
            help
                Set the Maximum TX power for the WiFi station. 
                Param power unit is 0.25dBm, range is [8, 84] corresponding to 2dBm - 20dBm.

    endmenu


    # ==================== MQTT sub-menu ====================
    menu "MQTT Configuration"

        config ESP_MQTT_BROKER_URL
            string "Broker URL"
            default "mqtt://test.mosquitto.org:1883"
            help
                MQTT broker URL for the example to connect to.
                Format: mqtt://hostname:port or mqtts://hostname:port

    endmenu

endmenu
```

## sdkconfig.defaults
```kconfig
CONFIG_ESP_WIFI_SOFTAP_SUPPORT=n
CONFIG_ESPTOOLPY_FLASHSIZE_4MB=y
CONFIG_PARTITION_TABLE_CUSTOM=y
CONFIG_PARTITION_TABLE_CUSTOM_FILENAME="partitions.csv"
CONFIG_PARTITION_TABLE_FILENAME="partitions.csv"
CONFIG_BOOTLOADER_APP_ROLLBACK_ENABLE=y
CONFIG_FREERTOS_USE_TICKLESS_IDLE=y
CONFIG_PM_ENABLE=y
```
